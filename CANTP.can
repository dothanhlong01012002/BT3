/*@!Encoding:1252*/

variables {
  // Frame types and Flow Status
  const byte FRAME_SF = 0x00;  // Single Frame
  const byte FRAME_FF = 0x10;  // First Frame
  const byte FRAME_CF = 0x20;  // Consecutive Frame
  const byte FRAME_FC = 0x30;  // Flow Control Frame
  const byte FC_CTS = 0x00;    // Continue to Send
  const byte FC_WAIT = 0x01;   // Wait
  const byte FC_OVF = 0x02;    // Overflow

  // Timer durations (ms)
  const dword N_AS_TIMEOUT = 1000;
  const dword N_AR_TIMEOUT = 1000;
  const dword N_BS_TIMEOUT = 1000;
  const dword N_BR_TIMEOUT = 2000;
  const dword N_CS_TIMEOUT = 2000;
  const dword N_CR_TIMEOUT = 1000;

  // Configuration
  byte BS;                     // Block Size
  byte STMIN;                  // Separation Time (ms)
  byte PADDING = 0xCC;         // Padding value
  byte FS;                     // Flow Status

  // States
  const byte STATE_IDLE = 0;
  const byte STATE_RUNNING = 1;

  // Buffers and state
  byte tx_buffer[4095];
  byte rx_buffer[4095];
  dword tx_length;
  dword rx_length;
  dword cf_received;
  byte seq_num;
  byte sender_state;
  byte receiver_state;
  dword cf_offset;
  
  msTimer t_NAs;
  msTimer t_NAr;
  msTimer t_NBs;
  msTimer t_NBr;
  msTimer t_NCs;
  msTimer t_NCr;
  
  msTimer t_STmin;
}

// Initialize CAN-TP
void cantp_init() {
  tx_length = 0;
  rx_length = 0;
  
  cf_received = 0;
  seq_num = 1;
  cf_offset = 6;
  
  sender_state = STATE_IDLE;
  receiver_state = STATE_IDLE;
  
  cancelTimer(t_NAs);
  cancelTimer(t_NBs);
  cancelTimer(t_NAr);
  cancelTimer(t_NBr);
  cancelTimer(t_NCs);
  cancelTimer(t_NCr);

  cancelTimer(t_STmin);
}

// Send Single Frame
void cantp_send_sf(message *Txmsgx, byte data[], dword length) {
  byte i;
  Txmsgx.dlc = 8;
  Txmsgx.byte(0) = FRAME_SF | (length & 0x0F);
  for (i = 0; i < length; i++) {
    Txmsgx.byte(i + 1) = data[i];
  }
  for (i = length + 1; i < 8; i++) {
    Txmsgx.byte(i) = PADDING;
  }
  
  setTimer(t_NAs, N_AS_TIMEOUT);
  output(Txmsgx);
  
  if (Txmsgx.TxFailed == 0) {
    cancelTimer(t_NAs);
  }
}

// Send First Frame
void cantp_send_ff(message *Txmsgx, byte data[], dword length) {
  byte i;
  Txmsgx.dlc = 8;
  Txmsgx.byte(0) = FRAME_FF | ((length >> 8) & 0x0F);
  Txmsgx.byte(1) = length & 0xFF;
  for (i = 0; i < 6; i++) {
    Txmsgx.byte(i + 2) = data[i];
  }
  for (i = 6; i < 8; i++) {
    Txmsgx.byte(i) = PADDING;
  }
  
  setTimer(t_NAs, N_AS_TIMEOUT);
  output(Txmsgx);
  
  if (Txmsgx.TxFailed == 0) {
    cancelTimer(t_NAs);
    setTimer(t_NBs, N_BS_TIMEOUT);
  }
}

// Send Consecutive Frame
void cantp_send_cf(message *Txmsgx, byte data[], dword offset, byte seq) {
  byte i, len;
  len = (tx_length - offset > 7) ? 7 : (tx_length - offset);
  Txmsgx.dlc = 8;
  Txmsgx.byte(0) = FRAME_CF | (seq & 0x0F);
  for (i = 0; i < len; i++) {
    Txmsgx.byte(i + 1) = data[offset + i];
  }
  for (i = len + 1; i < 8; i++) {
    Txmsgx.byte(i) = PADDING;
  }
  cf_received++;
  
  cancelTimer(t_NCs);
  setTimer(t_NAs, N_AS_TIMEOUT);
  output(Txmsgx);

  if (Txmsgx.TxFailed == 0) {
    cancelTimer(t_NAs);
  }
}

// Send Flow Control Frame
void cantp_send_fc(message *Txmsgx, byte fs, byte bs, byte stmin) {
  byte i;
  Txmsgx.dlc = 8;
  Txmsgx.byte(0) = FRAME_FC | (fs & 0x0F);
  Txmsgx.byte(1) = bs;
  Txmsgx.byte(2) = stmin;
  for (i = 3; i < 8; i++) {
    Txmsgx.byte(i) = PADDING;
  }
  
  cancelTimer(t_NBr);
  setTimer(t_NAr,N_AR_TIMEOUT);
  output(Txmsgx);
  
  if (Txmsgx.TxFailed == 0) {
    cancelTimer(t_NAr);
    setTimer(t_NCr,N_CR_TIMEOUT);
  }
}

void cantp_handle_sf(message *Rxmsgx)
{
  byte i;
  rx_length = Rxmsgx.byte(0) & 0x0F;
  for (i = 0; i < rx_length; i++) {
    rx_buffer[i] = Rxmsgx.byte(i + 1);
  }
  write("Received SF, %d bytes", rx_length);
}

void cantp_handle_ff(message *Rxmsgx, message *Txmsgx)
{
  byte i;
  rx_length = ((Rxmsgx.byte(0) & 0x0F) << 8) | Rxmsgx.byte(1);
  for (i = 0; i < 6; i++) {
    rx_buffer[i] = Rxmsgx.byte(i + 2);
  }
  setTimer(t_NBr,N_BR_TIMEOUT);
  cantp_send_fc(Txmsgx, FC_CTS, BS, STMIN);
  write("Received FF, total %d bytes", rx_length);
}

void cantp_handle_cf(message *Rxmsgx, message *Txmsgx)
{
  dword offset;
  byte seq, i, len;
  
  seq = Rxmsgx.byte(0) & 0x0F;
  if (seq != seq_num) {
    write("Invalid sequence number %d, expected %d", seq, seq_num);
    cantp_init();
    return;
  }
  offset = 6 + (seq - 1) * 7;
  len = (rx_length - offset > 7) ? 7 : (rx_length - offset);
  for (i = 0; i < len; i++) {
    rx_buffer[offset + i] = Rxmsgx.byte(i + 1);
  }
  seq_num = (seq_num + 1) % 16;
  cf_received++;
  cancelTimer(t_NCr);
  
  if (offset + len >= rx_length) {
    write("Received all CFs, total %d bytes", rx_length);
    cantp_init();
  } else if (BS != 0 && cf_received >= BS) {
    setTimer(t_NBr,N_BR_TIMEOUT);
    cantp_send_fc(Txmsgx, FC_CTS, BS, STMIN);
    cf_received = 0;
  } else {
    setTimer(t_NCr,N_CR_TIMEOUT);
  }
}

void cantp_handle_fc(message *Rxmsgx, message *Txmsgx)
{
  byte fs, bs, stmin;
  
  fs = Rxmsgx.byte(0) & 0x0F;
  bs = Rxmsgx.byte(1);
  stmin = Rxmsgx.byte(2);
  
  if (fs == FC_CTS) {
    if (cf_offset < tx_length) {
      cancelTimer(t_NBs);
      setTimer(t_NCs,N_CS_TIMEOUT);
      setTimer(t_STmin, STMIN);
    }
  } else if (fs == FC_WAIT) {
    write("Receiver requested wait");
  } else if (fs == FC_OVF) {
    write("Receiver overflow");
    cantp_init();
  }
}