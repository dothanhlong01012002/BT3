/*@!Encoding:1252*/

variables {
  // Frame types and Flow Status
  const byte FRAME_SF = 0x00;  // Single Frame
  const byte FRAME_FF = 0x10;  // First Frame
  const byte FRAME_CF = 0x20;  // Consecutive Frame
  const byte FRAME_FC = 0x30;  // Flow Control Frame
  const byte FC_CTS = 0x00;    // Continue to Send
  const byte FC_WAIT = 0x01;   // Wait
  const byte FC_OVF = 0x02;    // Overflow

  const byte MAX_FC_WAIT = 100; // maximum number of FC.WAIT frames
  const dword SEND_FC_WAIT_TIMEOUT = 20; // maximum number of FC.WAIT frames
  const byte PADDING = 0xCC;    // Padding value

  const byte SF_MAX_DATA_LEN     = 7;   // Max data in Single Frame
  const byte FF_DATA_LEN         = 6;   // Data bytes in First Frame
  const byte CF_DATA_LEN         = 7;   // Max data in Consecutive Frame
  const byte CAN_DLC             = 8;   // CAN Data Length Code
  const byte SEQ_NUM_INIT        = 1;   // Initial sequence number
  const byte SEQ_NUM_MODULO      = 16;  // SN rollover modulo
  
  const dword MIN_DATA_LENGTH = 0;
  const dword MAX_DATA_LENGTH = 4095;
  
  const byte LOW_NIBBLE_MASK = 0x0F;
  const byte HIGH_NIBBLE_MASK = 0xF0;
  const byte BYTE_MASK = 0xFF;
  
  // Configuration
  byte g_block_size;            // Block Size
  byte g_stmin;                 // Separation Time (ms)
  byte g_flow_status;           // Flow Status

  byte g_fs_receive,g_bs_receive, g_stmin_receive;
  // Buffers and state
  byte g_tx_buffer[4095];
  byte g_rx_buffer[4095];
  dword g_tx_length;
  dword g_rx_length;
  dword g_cf_received;
  dword g_seq_num;
  dword g_cf_offset;
  dword g_rx_offset;
  dword g_fc_wait_sent;
  
  // Parameter timers
  msTimer t_NBr;
  msTimer t_NCs;
  
  message *tx_message;
  message *rx_message;
}

/**
 * @brief Initialize CAN Transport Protocol internal variables and timers.
 */
void cantp_init() {
  g_tx_length = MIN_DATA_LENGTH;
  g_rx_length = MIN_DATA_LENGTH;
  
  g_seq_num = SEQ_NUM_INIT;
  g_cf_offset = FF_DATA_LEN;
  g_rx_offset = FF_DATA_LEN;
  g_fc_wait_sent = 0;
  g_cf_received = 0;
  
  cancelTimer(t_NCs);
  cancelTimer(t_NBr);
}

/**
 * @brief Send a Single Frame (SF) message for payloads = 7 bytes.
 * 
 * @param tx_message : Pointer to the CAN message structure to transmit.
 * @param data : Payload data to send.
 * @param length : Length of the data.
 */
void cantp_send_single_frame(message *tx_message, byte data[], dword length) {
  dword i;
  tx_message.dlc = CAN_DLC;
  tx_message.byte(0) = FRAME_SF | (length & LOW_NIBBLE_MASK);
  for (i = 0; i < length; i++) {
    tx_message.byte(i + 1) = data[i];
  }
  for (i = length + 1; i < CAN_DLC; i++) {
    tx_message.byte(i) = PADDING;
  } 
  output(tx_message);
}

/**
 * @brief Send a First Frame (FF) message for payloads > 7 bytes.
 * 
 * @param tx_message : Pointer to the CAN message structure to transmit.
 * @param data : Payload data to send.
 * @param length : Total length of the complete message.
 */
void cantp_send_first_frame(message *tx_message, byte data[], dword length) {
  dword i;
  tx_message.dlc = CAN_DLC;
  tx_message.byte(0) = FRAME_FF | ((length >> 8) & LOW_NIBBLE_MASK);
  tx_message.byte(1) = length & BYTE_MASK;
  for (i = 0; i < FF_DATA_LEN; i++) {
    tx_message.byte(i + 2) = data[i];
  }
  output(tx_message);
}

/**
 * @brief Send a Consecutive Frame (CF) during multi-frame transmission.
 * 
 * @param tx_message : Pointer to the CAN message structure to transmit.
 * @param data : Full payload buffer.
 * @param offset : Current offset in the payload buffer.
 * @param seq : Sequence number of the current CF (0-15).
 */
void cantp_send_consecutive_frame(message *tx_message, byte data[], dword offset, byte seq) {
  dword i, len;
  len = (g_tx_length - offset > CF_DATA_LEN) ? CF_DATA_LEN : (g_tx_length - offset);
  tx_message.dlc = CAN_DLC;
  tx_message.byte(0) = FRAME_CF | (seq & LOW_NIBBLE_MASK);
  for (i = 0; i < len; i++) {
    tx_message.byte(i + 1) = data[offset + i];
  }
  for (i = len + 1; i < CAN_DLC; i++) {
    tx_message.byte(i) = PADDING;
  }
  g_cf_received++;
  output(tx_message);
}

/**
 * @brief Send a Flow Control (FC) frame to control the sender's behavior.
 * 
 * @param tx_message : Pointer to the CAN message structure to transmit.
 * @param fs : Flow status (CTS, WAIT, OVF).
 * @param bs : Block size.
 * @param stmin : Minimum separation time between CFs.
 */
void cantp_send_flow_control_frame(message *tx_message, byte fs, byte bs, byte stmin) {
  dword i;
  tx_message.dlc = CAN_DLC;
  tx_message.byte(0) = FRAME_FC | (fs & LOW_NIBBLE_MASK);
  tx_message.byte(1) = bs;
  tx_message.byte(2) = stmin;
  for (i = 3; i < CAN_DLC; i++) {
    tx_message.byte(i) = PADDING;
  };
  output(tx_message);
}

/**
 * @brief Process a received Single Frame (SF).
 * 
 * @param rx_message : Pointer to the received CAN message structure.
 */
void cantp_process_single_frame(message *rx_message)
{
  dword i;
  g_rx_length = rx_message.byte(0) & LOW_NIBBLE_MASK;
  for (i = 0; i < g_rx_length; i++) {
    g_rx_buffer[i] = rx_message.byte(i + 1);
  }
  write("Received SF, %d bytes", g_rx_length);
}

/**
 * @brief Process a received First Frame (FF) and set timer to send FC.
 * 
 * @param rx_message : Pointer to the received CAN message structure.
 */
void cantp_process_first_frame(message *rx_message)
{
  dword i;
  g_rx_length = ((rx_message.byte(0) & LOW_NIBBLE_MASK) << 8) | rx_message.byte(1);
  for (i = 0; i < FF_DATA_LEN; i++) {
    g_rx_buffer[i] = rx_message.byte(i + 2);
  }
  setTimer(t_NBr,SEND_FC_WAIT_TIMEOUT);
  write("Received FF, total %d bytes", g_rx_length);
}

/**
 * @brief Process a received Consecutive Frame (CF).
 * 
 * @param rx_message : Pointer to the received CAN message structure.
 */
void cantp_process_consecutive_frame(message *rx_message)
{
  dword seq, i, len;
  
  seq = rx_message.byte(0) & LOW_NIBBLE_MASK;
  if (seq != g_seq_num) {
    write("Invalid sequence number %d, expected %d", seq, g_seq_num);
    cantp_init();
    return;
  } else {
    // Do nothing
  }
  len = (g_rx_length - g_rx_offset > CF_DATA_LEN) ? CF_DATA_LEN : (g_rx_length - g_rx_offset);
  for (i = 0; i < len; i++) {
    g_rx_buffer[g_rx_offset + i] = rx_message.byte(i + 1);
  }
  g_seq_num = (g_seq_num + 1) % SEQ_NUM_MODULO;
  g_cf_received++;
  
  if (g_rx_offset + len >= g_rx_length) {
    write("Received all CFs, total %d bytes", g_rx_length);
    len = 0;
    cantp_init();
  } else if (g_block_size != 0 && g_cf_received >= g_block_size) {
    setTimer(t_NBr,SEND_FC_WAIT_TIMEOUT);
    g_cf_received = 0;
  } else {
    // Do nothing
  }
  g_rx_offset += len;
}

/**
 * @brief Process a received Flow Control (FC) frame and handle flow status.
 * 
 * @param rx_message : Pointer to the received CAN message structure.
 */
void cantp_process_flow_control_frame(message *rx_message)
{ 
  g_fs_receive = rx_message.byte(0) & LOW_NIBBLE_MASK;
  g_bs_receive = rx_message.byte(1);
  g_stmin_receive = rx_message.byte(2);
  
  if (g_fs_receive == FC_CTS) {
    if (g_cf_offset < g_tx_length) {
      setTimer(t_NCs, g_stmin_receive);
    } else {
      // Do nothing
    }
  } else if (g_fs_receive == FC_WAIT) {
    write("Receiver requested wait");
  } else if (g_fs_receive == FC_OVF) {
    write("Receiver overflow");
    cantp_init();
  } else {
    // Do nothing
  }
}

/**
 * @brief Process a received CAN TP message and dispatch to appropriate handler.
 * 
 * @param Rxmsgx : Pointer to the received CAN message.
 * @param tx_message : Pointer to the message structure for responses.
 */
void cantp_rx_process_message(message *rx_message)
{
  if ((rx_message.byte(0) & HIGH_NIBBLE_MASK) == FRAME_SF) {
    cantp_process_single_frame(rx_message);
  } else if ((rx_message.byte(0) & HIGH_NIBBLE_MASK) == FRAME_FF) {
    cantp_process_first_frame(rx_message);
  } else if ((rx_message.byte(0) & HIGH_NIBBLE_MASK) == FRAME_CF) {
    cantp_process_consecutive_frame(rx_message);
  } else if ((rx_message.byte(0) & HIGH_NIBBLE_MASK) == FRAME_FC) {
    cantp_process_flow_control_frame(rx_message);
  } else {
    // Do nothing
  }
}

/**
 * @brief Callback function to send the next Consecutive Frame after STmin delay.
 * 
 * @param tx_message : Pointer to the CAN message structure to send.
 */
void cantp_handle_send_cf_on_stmin(message *tx_message)
{
  if (g_cf_offset < g_tx_length) {
    cantp_send_consecutive_frame(tx_message, g_tx_buffer, g_cf_offset, g_seq_num);
    g_cf_offset += CF_DATA_LEN;
    g_seq_num = (g_seq_num + 1) % SEQ_NUM_MODULO;
    
    if (g_cf_offset >= g_tx_length) {
      cantp_init();
    } else if (g_bs_receive != 0 && (g_cf_received >= g_bs_receive)) {
      g_cf_received = 0;
    } else {
      setTimer(t_NCs, g_stmin_receive);
    }
  } else {
    cantp_init();
  }
}

/**
 * @brief Prepare and transmit a CAN TP message (either SF or FF depending on length).
 * 
 * @param tx_message : Pointer to the CAN message structure to send.
 */
void cantp_tx_send_message(message *tx_message)
{
  dword i;
  
  if (g_tx_length <= MIN_DATA_LENGTH || g_tx_length > MAX_DATA_LENGTH) {
    write("ID 0x%03X: Invalid tx_length (%d)", tx_message.id,g_tx_length);
    return;
  } else {
    // Do nothing
  }
 
  for (i = 0; i < g_tx_length; i++) {
    g_tx_buffer[i] = i % 255 + 1;
  }
  
  if (g_tx_length <= SF_MAX_DATA_LEN) {
    cantp_send_single_frame(tx_message, g_tx_buffer, g_tx_length);
  } else {
    cantp_send_first_frame(tx_message, g_tx_buffer, g_tx_length);
  }
  write("ID 0x%03X sent %d bytes", tx_message.id,g_tx_length);
}

on timer t_NCs
{
  cantp_handle_send_cf_on_stmin(tx_message);
}

on timer t_NBr
{
  cantp_send_flow_control_frame(tx_message, g_flow_status, g_block_size, g_stmin);
  if (g_flow_status == FC_WAIT && g_fc_wait_sent != MAX_FC_WAIT)
  {
    g_fc_wait_sent++;
    setTimer(t_NBr,SEND_FC_WAIT_TIMEOUT);
  } else if (g_fc_wait_sent == MAX_FC_WAIT) {
    cantp_init();
  } else {
    // Do nothing
  }
}
