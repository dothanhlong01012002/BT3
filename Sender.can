/*@!Encoding:1252*/

includes
{
  #include "CANTP.can"
}

variables
{
  message 0x123 TxMsgID123;
  message 0x456 RxMsgID456;
}

on start
{
  cantp_init();
  write("ECU1 initialized");
}

on key 'q'
{
  cantp_handle_send_message(TxMsgID123);
}

on message 0x456
{
  RxMsgID456 = this;
  cantp_handle_received_frame(RxMsgID456,TxMsgID123);
}

on timer t_STmin
{
  cantp_handle_send_cf_on_stmin(TxMsgID123);
}

on timer t_sendFCWaitTimer
{
  cantp_send_fc(TxMsgID123, FS, BS, STMIN);
  if (FS == FC_WAIT && g_fc_wait_sent != MAX_FC_WAIT)
  {
    g_fc_wait_sent++;
    setTimer(t_sendFCWaitTimer,SEND_FC_WAIT_TIMEOUT);
  } else {
    //Do nothing
  }
}

on sysvar PANEL1::sysvar_tx_length
{
  g_tx_length = @PANEL1::sysvar_tx_length;
}
on sysvar PANEL1::sysvar_BS
{
  BS = @PANEL1::sysvar_BS;
}
on sysvar PANEL1::sysvar_STmin
{
  STMIN = @PANEL1::sysvar_STmin;
}
on sysvar PANEL1::sysvar_FS
{
  FS = @PANEL1::sysvar_FS;
}