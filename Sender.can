/*@!Encoding:1252*/

includes
{
  #include "CANTP.can"
}

variables
{
  message 0x123 MsgID123;
  message 0x456 RxMsg;
}

on start
{
  cantp_init();
  write("ECU1 initialized");
}

on key 'q'
{
  byte i;
  updateVar();
  
  if (sender_state != STATE_IDLE) {
    write("ECU1: Sender busy");
    return;
  }
  sender_state = STATE_RUNNING;
  if (tx_length == 0 || tx_length > 4095) {
    write("ECU1: Invalid tx_length (%d)", tx_length);
    return;
  }
  
  for (i = 0; i < tx_length; i++) {
    tx_buffer[i] = i + 1;
  }
  
  cf_received = 0;
  cf_offset = 6;
  
  if (tx_length <= 7) {
    cantp_send_sf(MsgID123, tx_buffer, tx_length);
  } else {
    cantp_send_ff(MsgID123, tx_buffer, tx_length);
  }
  write("ECU1 sent %d bytes", tx_length);
  sender_state = STATE_IDLE;
}

on message 0x456
{
  receiver_state = STATE_RUNNING;
  updateVar();
  RxMsg = this;
  
  if ((RxMsg.byte(0) & 0xF0) == FRAME_SF) {
    cantp_handle_sf(RxMsg);
  } else if ((RxMsg.byte(0) & 0xF0) == FRAME_FF) {
    cantp_handle_ff(RxMsg, MsgID123);
  } else if ((RxMsg.byte(0) & 0xF0) == FRAME_CF) {
    cantp_handle_cf(RxMsg, MsgID123);
  } else if ((RxMsg.byte(0) & 0xF0) == FRAME_FC) {
    cantp_handle_fc(RxMsg, MsgID123);
  }
  receiver_state = STATE_IDLE;
}

on timer t_STmin
{
  if (cf_offset < tx_length) {
    cantp_send_cf(MsgID123, tx_buffer, cf_offset, seq_num);
    cf_offset += 7;
    seq_num = (seq_num + 1) % 16;
    
    if (BS != 0 && (cf_received >= BS || cf_offset >= tx_length)) {
      cf_received = 0;
      setTimer(t_NBs,N_BS_TIMEOUT);
    } else {
      setTimer(t_NCs,N_CS_TIMEOUT);
      setTimer(t_STmin, STMIN);
    }
  }
}

on timer t_NAs
{
  write("ECU1: N_As timeout");
  cantp_init();
}

on timer t_NBs
{
  write("ECU1: N_Bs timeout (no FC received)");
  cantp_init();
}

on timer t_NCr
{
  write("ECU1: N_Cr timeout (no CF received)");
  cantp_init();
}

on timer t_NAr
{
  write("ECU1: N_Ar timeout");
  cantp_init();
}

on timer t_NBr
{
  write("ECU1: N_Bs timeout (no FC sent)");
  cantp_init();
}

on timer t_NCs
{
  write("ECU1: N_Cs timeout (no CF sent)");
  cantp_init();
}

updateVar()
{
  if (sender_state == STATE_IDLE && receiver_state == STATE_IDLE) {
    tx_length = @PANEL1::sysvar_tx_length;
    BS = @PANEL1::sysvar_BS;
    STMIN = @PANEL1::sysvar_STmin;
    FS = @PANEL1::sysvar_FS;
  }
}