/*@!Encoding:1252*/
includes
{
  #include "CANTP.can"
}

variables
{
  message 0x123 MsgID123;
  message 0x456 RxMsg;
}

on start
{
  cantp_init();
  write("Sender ECU1 initialized");
}

on key 's'
{
  byte i;
  for (i = 0; i < tx_length; i++) {
    tx_buffer[i] = i + 1;
  }
  
  if (tx_length <= 7) {
    cantp_send_sf(MsgID123, tx_buffer, tx_length);
  } else {
    cantp_send_ff(MsgID123, tx_buffer, tx_length);
  }
  write("ECU1 sent %d bytes", tx_length);
}

on message 0x456
{
  RxMsg = this;
  
  if ((RxMsg.byte(0) & 0xF0) == FRAME_SF) {
    cantp_handle_sf(RxMsg);
  } 
  else if ((RxMsg.byte(0) & 0xF0) == FRAME_FF) {
    cantp_handle_ff(RxMsg,MsgID123);
  } 
  else if ((RxMsg.byte(0) & 0xF0) == FRAME_CF) {
    cantp_handle_cf(RxMsg,MsgID123);
  }
  else if ((RxMsg.byte(0) & 0xF0) == FRAME_FC) {
    cantp_handle_fc(RxMsg,MsgID123);
  }
}