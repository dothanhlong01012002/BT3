/*@!Encoding:1252*/

includes
{
  #include "CANTP.can"
}

variables
{
  message 0x456 TxMsgID456;
  message 0x123 RxMsgID123;
}

on start
{
  cantp_init();
  write("ECU2 initialized");
}

on key 'p'
{
  cantp_handle_send_message(TxMsgID456);
}

on message 0x123
{
  RxMsgID123 = this;
  cantp_handle_received_frame(RxMsgID123,TxMsgID456);
}

on timer t_STmin
{
  cantp_handle_send_cf_on_stmin(TxMsgID456);
}

on timer t_sendFCWaitTimer
{
  cantp_send_fc(TxMsgID456, FS, BS, STMIN);
  if (FS == FC_WAIT && g_fc_wait_sent != MAX_FC_WAIT)
  {
    g_fc_wait_sent++;
    setTimer(t_sendFCWaitTimer,SEND_FC_WAIT_TIMEOUT);
  } else {
    //Do nothing
  }
}

on sysvar PANEL2::sysvar_tx_length
{
  g_tx_length = @PANEL2::sysvar_tx_length;
}
on sysvar PANEL2::sysvar_BS
{
  BS = @PANEL2::sysvar_BS;
}
on sysvar PANEL2::sysvar_STmin
{
  STMIN = @PANEL2::sysvar_STmin;
}
on sysvar PANEL2::sysvar_FS
{
  FS = @PANEL2::sysvar_FS;
}