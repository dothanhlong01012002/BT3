/*@!Encoding:1252*/
includes
{
  #include "cantp.can"
}

variables
{
  message 0x456 MsgID456;
  message 0x123 RxMsg;
}

on start
{
  cantp_init();
  write("Receiver ECU2 initialized");
}

on message 0x123
{
  RxMsg = this;
  
  if ((RxMsg.byte(0) & 0xF0) == FRAME_SF) {
    cantp_handle_sf(RxMsg);
  } 
  else if ((RxMsg.byte(0) & 0xF0) == FRAME_FF) {
    cantp_handle_ff(RxMsg,MsgID456);
  } 
  else if ((RxMsg.byte(0) & 0xF0) == FRAME_CF) {
    cantp_handle_cf(RxMsg,MsgID456);
  }
  else if ((RxMsg.byte(0) & 0xF0) == FRAME_FC) {
    cantp_handle_fc(RxMsg,MsgID456);
  }
}