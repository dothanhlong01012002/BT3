/*@!Encoding:1252*/

includes
{
  #include "CANTP.can"
}

variables
{
  byte last_button_state = 0;
}

on start
{
  cantp_init();
  tx_message.id = 0x456;
  rx_message.id = 0x123;
  write("ECU2 initialized");
}

on sysvar PANEL2::sysvar_button_pressed
{
  byte button_state;
  button_state = @this;
  if (button_state == 1 && last_button_state == 0) {
    update_panel_variable();
    cantp_tx_send_message(tx_message);
  } else {
    //Do nothing
  }
  last_button_state = last_button_state;
}

on message 0x123
{
  update_panel_variable();
  rx_message = this;
  cantp_rx_process_message(rx_message);
}

on sysvar PANEL2::sysvar_tx_length
{
  g_tx_length = @PANEL2::sysvar_tx_length;
}

on sysvar PANEL1::sysvar_PADDING
{
  g_padding_status = @PANEL1::sysvar_PADDING;
}

on sysvar PANEL2::sysvar_BS
{
  int bs;
  bs = @PANEL2::sysvar_BS;
  if (bs < 0 || bs > 255) {
    write("Invalid BS = %d (must be 0-255)", bs);
    return;
  }
  g_block_size = bs;
}

on sysvar PANEL2::sysvar_STmin
{
  int stmin;
  stmin = @PANEL2::sysvar_STmin;
  if (stmin < 0 || stmin > 127) {
    write("Invalid STmin_ECU1 = %d (must be 0-127)", stmin);
    return;
  }
  g_stmin = stmin;
}

on sysVar PANEL2::sysvar_FS
{
  int fs;
  fs = @PANEL2::sysvar_FS;
  if (fs != FC_CTS && fs != FC_WAIT && fs != FC_OVF) {
    write("Invalid FS = %d (must be 0=CTS, 1=WAIT, 2=OVERFLOW)", fs);
    return;
  }
  g_flow_status = fs;
}
void update_panel_variable()
{
  g_tx_length = @PANEL2::sysvar_tx_length;
  g_block_size = @PANEL2::sysvar_BS;
  g_stmin = @PANEL2::sysvar_STmin;
  g_flow_status = @PANEL2::sysvar_FS;
}